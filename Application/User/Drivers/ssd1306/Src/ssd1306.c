#include "ssd1306.h"

#define REG_CLOCKDIV_ARG     0x80U
#define REG_MUX_ARG          0x3FU
#define REG_DISPLAYOFFSET_ARG 0x00U
#define REG_CHARGEPUMP_ARG   0x14U
#define REG_SEGREMAP_REMAP   0x01U
#define REG_COMPINS_ARG      0x12U
#define REG_CONTRAST_ARG     0x7FU
#define REG_PRECHARGE_ARG    0xF1U
#define REG_VCOMDETECT_ARG   0x40U

#define SSD1306_CMD          0x00U
#define SSD1306_DATA         0x40U

static const uint8_t s_font[96][FONT_WIDTH] =
{
    {0x00, 0x00, 0x00, 0x00, 0x00},
    {0x00, 0x00, 0x5F, 0x00, 0x00},
    {0x00, 0x07, 0x00, 0x07, 0x00},
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    {0x08, 0x04, 0x08, 0x10, 0x08},
};

static HAL_StatusTypeDef SSD1306_WriteCmd(SSD1306_HandleTypeDef *dev, uint8_t cmd)
{
    uint8_t tx[2] = {SSD1306_CMD, cmd};
    return HAL_I2C_Master_Transmit(dev->hi2c, dev->addr, tx, 2U, SSD1306_I2C_TIMEOUT_MS);
}

static bool SSD1306_InitSequence(SSD1306_HandleTypeDef *dev)
{
    if (SSD1306_WriteCmd(dev, 0xAEU) != HAL_OK) return false;
    HAL_Delay(10);

    if (SSD1306_WriteCmd(dev, 0xD5U) != HAL_OK) return false;
    if (SSD1306_WriteCmd(dev, REG_CLOCKDIV_ARG) != HAL_OK) return false;

    if (SSD1306_WriteCmd(dev, 0xA8U) != HAL_OK) return false;
    if (SSD1306_WriteCmd(dev, REG_MUX_ARG) != HAL_OK) return false;

    if (SSD1306_WriteCmd(dev, 0xD3U) != HAL_OK) return false;
    if (SSD1306_WriteCmd(dev, REG_DISPLAYOFFSET_ARG) != HAL_OK) return false;

    if (SSD1306_WriteCmd(dev, 0x40U) != HAL_OK) return false;

    if (SSD1306_WriteCmd(dev, 0x8DU) != HAL_OK) return false;
    if (SSD1306_WriteCmd(dev, REG_CHARGEPUMP_ARG) != HAL_OK) return false;

    if (SSD1306_WriteCmd(dev, 0xA0U | REG_SEGREMAP_REMAP) != HAL_OK) return false;
    if (SSD1306_WriteCmd(dev, 0xC8U) != HAL_OK) return false;

    if (SSD1306_WriteCmd(dev, 0xDAU) != HAL_OK) return false;
    if (SSD1306_WriteCmd(dev, REG_COMPINS_ARG) != HAL_OK) return false;

    if (SSD1306_WriteCmd(dev, 0x81U) != HAL_OK) return false;
    if (SSD1306_WriteCmd(dev, REG_CONTRAST_ARG) != HAL_OK) return false;

    if (SSD1306_WriteCmd(dev, 0xD9U) != HAL_OK) return false;
    if (SSD1306_WriteCmd(dev, REG_PRECHARGE_ARG) != HAL_OK) return false;

    if (SSD1306_WriteCmd(dev, 0xDBU) != HAL_OK) return false;
    if (SSD1306_WriteCmd(dev, REG_VCOMDETECT_ARG) != HAL_OK) return false;

    if (SSD1306_WriteCmd(dev, 0xA4U) != HAL_OK) return false;
    if (SSD1306_WriteCmd(dev, 0xA6U) != HAL_OK) return false;
    if (SSD1306_WriteCmd(dev, 0xAFU) != HAL_OK) return false;

    return true;
}

bool SSD1306_Init(SSD1306_HandleTypeDef *dev, I2C_HandleTypeDef *hi2c)
{
    if ((dev == NULL) || (hi2c == NULL)) return false;

    dev->hi2c = hi2c;
    dev->initialized = 0U;

#ifdef OLED_USE_SH1106
    dev->column_offset = SH1106_COLUMN_OFFSET;
#else
    dev->column_offset = SSD1306_COLUMN_OFFSET;
#endif

    HAL_Delay(10);

    if (!SSD1306_InitSequence(dev)) return false;

    dev->initialized = 1U;

    SSD1306_Clear(dev);
    SSD1306_Update(dev);

    return true;
}

bool SSD1306_InitSH1106(SSD1306_HandleTypeDef *dev, I2C_HandleTypeDef *hi2c)
{
    if ((dev == NULL) || (hi2c == NULL)) return false;

    dev->hi2c = hi2c;
    dev->initialized = 0U;
    dev->column_offset = SH1106_COLUMN_OFFSET;

    HAL_Delay(10);

    if (!SSD1306_InitSequence(dev)) return false;

    dev->initialized = 1U;

    SSD1306_Clear(dev);
    SSD1306_Update(dev);

    return true;
}

void SSD1306_Clear(SSD1306_HandleTypeDef *dev)
{
    if (dev == NULL) return;

    for (uint16_t i = 0U; i < sizeof(dev->buffer); i++)
    {
        dev->buffer[i] = 0x00U;
    }
}

void SSD1306_Update(SSD1306_HandleTypeDef *dev)
{
    uint8_t data_buf[SSD1306_WIDTH + 1];

    if ((dev == NULL) || (dev->initialized == 0U)) return;

    uint8_t low_col  = dev->column_offset & 0x0FU;
    uint8_t high_col = (dev->column_offset >> 4U) & 0x0FU;

    for (uint8_t page = 0U; page < SSD1306_PAGES; page++)
    {
        if (SSD1306_WriteCmd(dev, SSD1306_PAGE_CMD_BASE | page) != HAL_OK) return;
        if (SSD1306_WriteCmd(dev, 0x00U | low_col) != HAL_OK) return;
        if (SSD1306_WriteCmd(dev, 0x10U | high_col) != HAL_OK) return;

        data_buf[0] = SSD1306_DATA;
        for (uint8_t x = 0U; x < SSD1306_WIDTH; x++)
        {
            data_buf[x + 1] = dev->buffer[page * SSD1306_WIDTH + x];
        }
        if (HAL_I2C_Master_Transmit(dev->hi2c, dev->addr, data_buf, SSD1306_WIDTH + 1U, SSD1306_I2C_TIMEOUT_MS) != HAL_OK) return;
    }
}

void SSD1306_DrawPixel(SSD1306_HandleTypeDef *dev, uint8_t x, uint8_t y, uint8_t color)
{
    if (dev == NULL) return;
    if ((x >= SSD1306_WIDTH) || (y >= SSD1306_HEIGHT)) return;

    if (color)
    {
        dev->buffer[x + (y / 8U) * SSD1306_WIDTH] |= (1U << (y % 8U));
    }
    else
    {
        dev->buffer[x + (y / 8U) * SSD1306_WIDTH] &= ~(1U << (y % 8U));
    }
}

void SSD1306_DrawChar(SSD1306_HandleTypeDef *dev, uint8_t x, uint8_t y, char ch)
{
    if (dev == NULL) return;

    uint8_t idx = (uint8_t)ch;
    if ((idx < 32U) || (idx > 127U))
    {
        idx = (uint8_t)'?';
    }
    idx -= 32U;

    for (uint8_t i = 0U; i < FONT_WIDTH; i++)
    {
        uint8_t line = s_font[idx][i];
        for (uint8_t j = 0U; j < FONT_HEIGHT; j++)
        {
            uint8_t pixel = (line & (1U << j)) ? 1U : 0U;
            SSD1306_DrawPixel(dev, x + i, y + j, pixel);
        }
    }
}

void SSD1306_DrawString(SSD1306_HandleTypeDef *dev, uint8_t x, uint8_t y, const char *str)
{
    if (dev == NULL) return;

    while (*str != '\0')
    {
        SSD1306_DrawChar(dev, x, y, *str);
        x += FONT_CHAR_SPACING;
        if (x + FONT_CHAR_SPACING >= SSD1306_WIDTH)
        {
            x = 0U;
            y += FONT_HEIGHT;
        }
        str++;
    }
}

void SSD1306_TestPattern(SSD1306_HandleTypeDef *dev)
{
    if (dev == NULL) return;

    SSD1306_Clear(dev);

    for (uint16_t i = 0U; i < sizeof(dev->buffer); i++)
    {
        dev->buffer[i] = 0xFFU;
    }

    for (uint8_t y = 0U; y < SSD1306_HEIGHT; y++)
    {
        for (uint8_t x = 0U; x < SSD1306_WIDTH; x++)
        {
            uint8_t px = ((x / 8U) + (y / 8U)) & 1U;
            if (px == 0U)
            {
                uint8_t page = y / 8U;
                dev->buffer[x + page * SSD1306_WIDTH] &= ~(1U << (y % 8U));
            }
        }
    }

    SSD1306_Update(dev);
}

bool SSD1306_IsInitialized(const SSD1306_HandleTypeDef *dev)
{
    if (dev == NULL) return false;
    return (dev->initialized != 0U);
}